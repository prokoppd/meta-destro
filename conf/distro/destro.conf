## conf/distro/destro.conf
```bitbake
DISTRO = "destro"
DISTRO_NAME = "Destro Project Distro"
DISTRO_VERSION = "1.0"

require conf/distro/poky.conf

ENABLE_UART = "1"
ENABLE_SPI = "1"
ENABLE_I2C = "1"

# Enable WiFi and Bluetooth
ENABLE_WLAN = "1"
ENABLE_BT = "1"

INIT_MANAGER = "systemd"

IMAGE_INSTALL:append = " linux-firmware-rpidistro-bcm43430 "

DISTRO_FEATURES:remove = "pulseaudio"
DISTRO_FEATURES:append = " pipewire"
DISTRO_FEATURES:append = " bluetooth"
DISTRO_FEATURES:append = " wifi"
DISTRO_FEATURES:append = " wpa-supplicant"
```

## conf/layer.conf
```bitbake
# We have a conf and classes directory, add to BBPATH
BBPATH .= ":${LAYERDIR}"

# We have recipes-* directories, add to BBFILES
BBFILES += "${LAYERDIR}/recipes-*/*/*.bb \
            ${LAYERDIR}/recipes-*/*/*.bbappend"

BBFILE_COLLECTIONS += "destro"
BBFILE_PATTERN_destro = "^${LAYERDIR}/"
BBFILE_PRIORITY_destro = "6"

LAYERDEPENDS_destro = "core"
LAYERSERIES_COMPAT_destro = "scarthgap"
# Allow this layer to provide a distro
BBFILES_DYNAMIC += "destro:${LAYERDIR}/conf/distro/*"
```
